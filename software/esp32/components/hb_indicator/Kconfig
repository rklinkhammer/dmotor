## software/esp32/components/hb_indicator/Kconfig
```kconfig
menu "DMOTOR heartbeat indicator"
config DMOTOR_HB_LED_GPIO
    int "Addressable RGB LED GPIO (38 for DevKitC-1 v1.1; 48 for original)"
    range 38 48
    default 48
endmenu
```

## software/esp32/diagnostics/bench/main/Kconfig.projbuild
```kconfig
menu "DMOTOR bench fixture"
config DMOTOR_PREPCB_HB_GPIO3
    bool "Pre-PCB fixture: synthetic heartbeat on GPIO3 instead of GPIO21"
    default n
    help
        Breadboard-only UART/U1 diagnostic routing. GPIO21 stays LOW.
        Leave disabled for the PCB heartbeat connection on GPIO21.
endmenu
```

## software/esp32/diagnostics/ina_timing/main/Kconfig.projbuild
```kconfig
menu "DMOTOR isolated INA / ADC timing"
config DMOTOR_TIMING_CYCLES
    int "Number of measured cycles (CSV emitted after capture)"
    range 1 128
    default 100
config DMOTOR_INA_ADDRESS
    hex "Preferred INA226 7-bit address when multiple scan addresses ACK"
    range 0x40 0x4f
    default 0x40
config DMOTOR_ADC_SAMPLES
    int "Raw conversions per ADC channel per cycle"
    range 1 16
    default 1
config DMOTOR_TIMING_IPROPI
    bool "Also time four IPROPI ADC channels on GPIO4..7"
    default n
config DMOTOR_RAW_TIMEOUT_PROBE
    bool "DIAGNOSTIC ONLY: pass raw 2 ms timeouts, including zero-tick conversion"
    default n
    help
        Bypasses the acquisition adapter's zero-tick rejection to characterize
        the stock driver. Still checks the absolute deadline after each call.
        No healthy qualification, permit, or heartbeat is ever generated.
config DMOTOR_TIMING_BATCHES
    int "Consecutive fixed-memory batches (console output only after final batch)"
    range 1 10000
    default 1
config DMOTOR_ACQUISITION_UART
    bool "Inhibited pre-PCB acquisition UART snapshots and deadline observer"
    default n
    depends on !DMOTOR_RAW_TIMEOUT_PROBE
config DMOTOR_SYNTHETIC_INPUTS
    bool "Synthetic ADC/INA data for UART load tests (not physical evidence)"
    default n
    depends on DMOTOR_ACQUISITION_UART
config DMOTOR_INJECT_EVERY
    int "Inject at every Nth cycle (0 disables)"
    range 0 1000000
    default 0
    depends on DMOTOR_ACQUISITION_UART
config DMOTOR_INJECT_DELAY
    bool "Inject a 20 ms delay instead of an I/O failure"
    default n
    depends on DMOTOR_ACQUISITION_UART
endmenu
```

## software/esp32/diagnostics/sensor_health/main/Kconfig.projbuild
```kconfig
menu "DMOTOR inhibited physical sensor health"
config DMOTOR_HEALTH_ADDRESS
    hex "Physical INA226 address (no discovery or alias slots)"
    range 0x40 0x4f
    default 0x44
config DMOTOR_HEALTH_CONFIG
    hex "Expected INA226 configuration (read-only verification)"
    default 0x4127
config DMOTOR_CONVERSION_BOUND_US
    int "Conservative conversion window bound us (requires board qualification)"
    range 1 24999
    default 2500
config DMOTOR_HEALTH_CYCLES
    int "Capture cycles (16 ms each; fixed 100-record tail)"
    range 100 100000
    default 10000
endmenu
```
